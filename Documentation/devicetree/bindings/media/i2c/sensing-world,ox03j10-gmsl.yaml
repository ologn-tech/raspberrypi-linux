## Documentation/devicetree/bindings/media/i2c/sensing-world,ox03j10-gmsl.yaml
```yaml
# SPDX-License-Identifier: (GPL-2.0 OR BSD-2-Clause)
%YAML 1.2
---
$id: http://devicetree.org/schemas/media/i2c/sensing-world,ox03j10-gmsl.yaml#
$schema: http://devicetree.org/meta-schemas/core.yaml#

title: Sensing World OX03J10 GMSL2 Camera Module

maintainers:
  - Raspberry Pi Kernel Maintainers <kernel-list@raspberrypi.com>

description:
  OX03J10 camera module connected through a Maxim MAX96717 serializer and
  MAX9296 GMSL2 deserializer. After SerDes bring-up the driver writes the
  firmware QSTS PLL/output table to the OX03J10 SoC and starts streaming.

allOf:
  - $ref: /schemas/media/video-interface-devices.yaml#

properties:
  compatible:
    const: sensing-world,ox03j10-gmsl

  reg:
    maxItems: 1
    description:
      I2C address used to instantiate the driver, normally the MAX9296
      deserializer address.

  max9296-addr:
    $ref: /schemas/types.yaml#/definitions/uint32
    description:
      Optional 7-bit I2C address of the MAX9296 deserializer. Defaults to
      0x48. Vendor 8-bit notation is also accepted by the driver.

  max96717-addr:
    $ref: /schemas/types.yaml#/definitions/uint32
    description:
      Optional 7-bit I2C address of the MAX96717 serializer. Defaults to
      0x40. Vendor 8-bit notation is also accepted by the driver.

  sensor-addr:
    $ref: /schemas/types.yaml#/definitions/uint32
    description:
      Optional 7-bit I2C address of the OX03J10 SoC. Defaults to 0x36
      (vendor 8-bit 0x6c). Vendor 8-bit notation is also accepted by the
      driver.

  port:
    $ref: /schemas/graph.yaml#/$defs/port-base
    unevaluatedProperties: false

    properties:
      endpoint:
        $ref: /schemas/media/video-interfaces.yaml#
        unevaluatedProperties: false

        properties:
          data-lanes:
            oneOf:
              - items:
                  - const: 1
              - items:
                  - const: 1
                  - const: 2
              - items:
                  - const: 1
                  - const: 2
                  - const: 3
                  - const: 4

          link-frequencies: true

        required:
          - data-lanes
          - link-frequencies

required:
  - compatible
  - reg
  - port

unevaluatedProperties: false

examples:
  - |
    i2c {
        #address-cells = <1>;
        #size-cells = <0>;

        camera@48 {
            compatible = "sensing-world,ox03j10-gmsl";
            reg = <0x48>;
            max9296-addr = <0x48>;
            max96717-addr = <0x40>;
            sensor-addr = <0x36>;

            port {
                endpoint {
                    clock-lanes = <0>;
                    data-lanes = <1 2 3 4>;
                    link-frequencies = /bits/ 64 <400000000>;
                    remote-endpoint = <&csi_endpoint>;
                };
            };
        };
    };
...
```
